## lab04/sdkconfig.defaults
```kconfig
#
# IDF Options
#
CONFIG_IDF_TARGET_ESP32=y
CONFIG_IDF_TARGET="esp32"

#
# Partition Table
#
# CONFIG_PARTITION_TABLE_CUSTOM=y
# CONFIG_PARTITION_TABLE_CUSTOM_FILENAME="partitions.csv"
# CONFIG_PARTITION_TABLE_FILENAME="partitions.csv"

#
# Serial Flasher Config
#
CONFIG_ESPTOOLPY_FLASHSIZE_4MB=y
CONFIG_ESPTOOLPY_FLASHSIZE="4MB"

#
# Compiler Options
#
CONFIG_COMPILER_OPTIMIZATION_PERF=y

#
# Disable Task Watchdog Timer
#
CONFIG_ESP_TASK_WDT_EN=n

#
# ESP System Settings
#
CONFIG_ESP_DEFAULT_CPU_FREQ_MHZ_240=y
CONFIG_ESP_DEFAULT_CPU_FREQ_MHZ=240
```
